#include "s2l.h"
#include "cmsis_os.h"
#include "stm32l0xx_hal.h"
#include "fhex.h"

extern osMessageQId UartQHandle;
extern UART_HandleTypeDef huart1;

/** CRC table for the CRC-16. The poly is 0x8005 (x^16 + x^15 + x^2 + 1) */
uint16_t const crc16_table[256] = {
	0x0000, 0xC0C1, 0xC181, 0x0140, 0xC301, 0x03C0, 0x0280, 0xC241,
	0xC601, 0x06C0, 0x0780, 0xC741, 0x0500, 0xC5C1, 0xC481, 0x0440,
	0xCC01, 0x0CC0, 0x0D80, 0xCD41, 0x0F00, 0xCFC1, 0xCE81, 0x0E40,
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	0x8201, 0x42C0, 0x4380, 0x8341, 0x4100, 0x81C1, 0x8081, 0x4040
};

uint16_t crc16(uint8_t data,uint16_t crc)
{
  return (crc >> 8) ^ crc16_table[(crc ^ data) & 0xff];
}

typedef enum
{
  IDLE=0U,
  SOF_1,
  SOF_2,
  LEN_1,
  LEN_2,
  CLEN_1,
  DATA,
  DONE
}FrameStateDef;

typedef struct
{
  FrameStateDef state;
  uint8_t* pdata;
}CmdTypeDef;


void S2lTask()
{
  osEvent evt;
  CmdTypeDef cmd;
  cmd.state=IDLE;
  
  uint16_t length,clen,crcseed;
  uint16_t tmpl; 
  __HAL_UART_ENABLE_IT(&huart1, UART_IT_RXNE);
  while(1)
  {
    evt=osMessageGet(UartQHandle,osWaitForever);
    uint8_t tmp;
    tmp=(uint8_t)evt.value.v;
    switch(cmd.state)
    {
    case IDLE:
      {
        if(tmp==0x55)
        {
          cmd.state=SOF_1;
          //osTimerStart(timeoutHandle,200);
        }
        else
        {
          cmd.state=IDLE;
        }
        break;
      }
    case SOF_1:
      {
        if(tmp==0xAA)
        {
          cmd.state=SOF_2;
          
        }
        else
        {
          cmd.state=IDLE;
          
        }
        break;
      }
    case SOF_2:
      {
        length=((uint16_t)tmp)<<8&0xff00;
        cmd.state=LEN_1;
        break;
      }
    case LEN_1:
      {
        length|=tmp;
        cmd.state=LEN_2;
        break;
      }
    case LEN_2:
      {
        clen=((uint16_t)tmp)<<8&0xff00;
        cmd.state=CLEN_1;
        break;
      }
    case CLEN_1:
      {
        clen|=tmp;
        clen=~clen;
        if(length!=clen)
        {
          cmd.state=IDLE;
          break;
        }
        tmpl=length;
        //data
        cmd.pdata=pvPortMalloc(length+7);
        cmd.pdata[0]=0x55;
        cmd.pdata[1]=0xaa;
        cmd.pdata[2]=(uint8_t)(length>>8);
        cmd.pdata[3]=(uint8_t)(length&0x00ff);
        cmd.pdata[4]=(uint8_t)(clen>>8);
        cmd.pdata[5]=(uint8_t)(clen&0x00ff);
        cmd.state=DATA;
        break;
      }
    case DATA:
      {
        tmpl--;
        cmd.pdata[5+length-tmpl]=tmp;
        if(tmpl==0)
        {
          cmd.state=DONE;
        }
        break;
      }
    case DONE:
      {
        //osTimerStop(timeoutHandle);
        cmd.state=IDLE;
        cmd.pdata[length+6]=0;
        crcseed=0xffff;
        for(int i=0;i<length-2;i++)
        {
          crcseed=crc16(cmd.pdata[i+6],crcseed);
        }
        if(crcseed==(cmd.pdata[length+4]<<8|cmd.pdata[length+5]))
        {
          //success
          SendAck();
          //
           uint16_t id;
          id=cmd.pdata[6]<<8|cmd.pdata[7];
          ExecCmd(id,cmd.pdata);
        }
        vPortFree(cmd.pdata);
        break;
      }
      
      
    }
  }
  
}






void USART1_IRQHandler(void)
{
  //if((__HAL_UART_GET_IT(&huart1, UART_IT_RXNE) != RESET) && (__HAL_UART_GET_IT_SOURCE(&huart1, UART_IT_RXNE)))
  {
    uint8_t tmp;
    tmp=huart1.Instance->RDR;
    osMessagePut (UartQHandle,(uint32_t)tmp,0);//no block in the inter
  }
  HAL_UART_IRQHandler(&huart1);
}